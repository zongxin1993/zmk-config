## boards/shields/zx/Kconfig.defconfig
```kconfig
if SHIELD_ZX_LEFT

config ZMK_KEYBOARD_NAME
    default "zx66"

config ZMK_SPLIT_ROLE_CENTRAL
    default y

endif

if SHIELD_ZX_LEFT || SHIELD_ZX_RIGHT

config ZMK_SPLIT
    default y

endif
```

## boards/shields/zx/Kconfig.shield
```kconfig
# Copyright (c) 2020 Pete Johanson
# SPDX-License-Identifier: MIT

config SHIELD_ZX_LEFT
    def_bool $(shields_list_contains,splitkb_zx_left)

config SHIELD_ZX_RIGHT
    def_bool $(shields_list_contains,splitkb_zx_right)
```
